/dts-v1/;
/plugin/;

/**
* @brief Changed w1-gpio to match PC4 instead of PD4
*/
/ {
	compatible = "allwinner,sun50i-a64";

	fragment@0 {
		target = <&pio>;
		__overlay__ {
			w1_pins: w1_pins {
				pins = "PC4";
				function = "gpio_in";
				pull = < 0x1 >;
				drive = < 0x0 >;
			};
		};
	};

	fragment@1 {
		target-path = "/";
		__overlay__ {
			onewire@0 {
				compatible = "w1-gpio";
				pinctrl-names = "default";
				pinctrl-0 = <&w1_pins>;
				gpios = <&pio 0x2 4 0>; /* PC4 */
				status = "okay";
			};
		};
	};
};
