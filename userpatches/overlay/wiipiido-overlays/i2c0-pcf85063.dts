/dts-v1/;
/plugin/;

/ {
	compatible = "allwinner,sun50i-a64";

/**
* @brief I2C0 : PCF85063 support for wiipiido board
* 2020-03-09: Changed overlay to host compilation on userpatches
*/
	fragment@0 {
		target-path = "/aliases";

		__overlay__ {
			i2c0 = "/soc/i2c@1c2ac00";
		};
	};


	fragment@1 {
		target = <&i2c0>;
		__overlay__ {
			#address-cells = <1>;
			#size-cells = <0>;
				
 			pcf85063: rtc@51{
			        compatible = "nxp,pcf85063";
			        reg = <0x51>;
        		};
		};
	};

	__fixups__ {
		i2c0 = "/fragment@1:target:0";
	};
};
