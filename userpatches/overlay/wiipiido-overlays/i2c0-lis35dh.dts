/dts-v1/;
/plugin/;

/ {
	compatible = "allwinner,sun50i-a64";

/**
* @brief I2C0 : LIS35DH / LIS3DE MEMS support for wiipiido board
*/
	fragment@0 {
		target-path = "/aliases";

		__overlay__ {
			i2c0 = "/soc/i2c@1c2ac00";
		};
	};

	fragment@1 {
		target = <&i2c0>;
		__overlay__ {
			#address-cells = <1>;
			#size-cells = <0>;

 			lis35dh: mems@29{
        			compatible = "st,lis3dh";
			        reg = <0x29>;
			        st,default-rate = <8>;
        		};
 		};
	};

	__fixups__ {
		i2c0 = "/fragment@1:target:0";
	};

};
